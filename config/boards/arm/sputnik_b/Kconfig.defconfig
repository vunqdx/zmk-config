## config/boards/arm/sputnik_b/Kconfig.defconfig
```kconfig
# Copyright (c) 2021 Nick Winans
# SPDX-License-Identifier: MIT

if BOARD_SPUTNIK_B

config ZMK_KEYBOARD_NAME
	default "Sputnik B"

if USB

config USB_NRFX
	default y

config USB_DEVICE_STACK
	default y

endif # USB

config BT_CTLR
	default BT

config ZMK_BLE
	default y

config ZMK_USB
	default y

config ZMK_BATTERY_NRF_VDDH
	default y

endif # BOARD_SPUTNIK_B
```

## config/boards/shields/sputnik_b/Kconfig.shield
```kconfig
# Copyright (c) 2020 Nick Winans
# SPDX-License-Identifier: MIT

config SHIELD_SPUTNIK_B
	def_bool $(shields_list_contains,sputnik_b)
```
